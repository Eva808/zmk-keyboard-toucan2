#include <dt-bindings/zmk/matrix_transform.h>
#include "toucan.dtsi"

/ {
    chosen {
        zmk,kscan = &mock_kscan;
        zmk,physical-layout = &default_layout;
    };

    mock_kscan: mock_kscan_0 {
        compatible = "zmk,kscan-mock";
        status = "okay";
        columns = <0>;
        rows = <0>;
        events = <>;
    };
};

/* Disable the inherited physical keyboard scanner. */
&kscan0 {
    status = "disabled";
};